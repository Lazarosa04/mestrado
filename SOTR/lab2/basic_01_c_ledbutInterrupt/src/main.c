/*
 * Paulo Pedreiras, 2025/07
 * 		Interrupt-driven simple Digital Input/Output example.
 *
 * 		Toggles LED1 when BUT1 is pressed, via interrupt. 
 *
 *	Base documentation:
 *
 *      HW info:
 *          https://docs.nordicsemi.com/category/nrf52840-category
 *          Resources -> Peripherals -> GPIO / GPIOTE
 *
 *          Board specific HW info can be found in "nRF52840 DK Hardware", https://docs.nordicsemi.com/bundle/ug_nrf52840_dk/page/UG/dk/intro.html
 * 			
 *		Notes:
 * 			- Note that the GPIO must be enabled
 * 				In this version it is set in nrf52880_dk default config, so there is no need to set it in prj.conf
 * 			- nrf52880_dk default config also sets "CONFIG_SERIAL=y", "CONFIG_CONSOLE=y" and "CONFIG_UART_CONSOLE=y",
 * 				so we can use printf() and get output on the vcom 
 */

/* Includes. Add according to the resources used  */
#include <zephyr/kernel.h>          /* for k_msleep() */
#include <zephyr/device.h>          /* for device_is_ready() and device structure */
#include <zephyr/devicetree.h>		/* for DT_NODELABEL() */
#include <zephyr/drivers/gpio.h>    /* for GPIO api*/

/* Define return codes */
#define ERR_DEV_NOT_READY	-1		/* If device_is_ready() fails*/

/* Get led0 and button0 node IDs. Refer to the DTS file */
#define LED0_NODE DT_ALIAS(led0)
#define BUT0_NODE DT_ALIAS(sw0)

/* Get the device pointer, pin number, and configuration flags for led0 and button 0. A build error on this line means your board is unsupported. */
static const struct gpio_dt_spec led1 = GPIO_DT_SPEC_GET(LED0_NODE, gpios);
static const struct gpio_dt_spec but1 = GPIO_DT_SPEC_GET(BUT0_NODE, gpios);

/* Define the callback function */
void buttonPressed(const struct device *dev, struct gpio_callback *cb, uint32_t pins)
{
	/* Callback is set to GPIO devices*/
	/* As BUT1 is the only GPIO interrupt active, the test below is not necessary */
	/*		Just the toggle line would be enough. */
	/* But if there are more interrupts generated by GPIO, we need to check them */
	/* Note that the device pointer indicates which GPIO generated the interrupt */
	if( (pins & BIT(but1.pin)) && (dev->name == but1.port->name)) {
    	gpio_pin_toggle_dt(&led1);
		printf("BUT1 pressed\n");
		printf(" Device is %s and pins is %x (hex)\n",dev->name, pins);
	} else {
		printf("Interrupt not recognized\n");
		printf(" Device is %s and pins is %x (hex)\n",dev->name, pins);
	}
	return; 
}

/*
 * The main function
 */
int main(void)
{
	int ret = 0;
	
	static struct gpio_callback buttonCbData; // Define variable for holding callback data 
	
	/* Check if devices are ready */
	if (!device_is_ready(led1.port) || !device_is_ready(but1.port)) {
		return ERR_DEV_NOT_READY;
	}	
	printf("BUT1 and LED 1 devices are ready\n");

	/* Configure the GPIO pins for input/output and set active logic */
	/* Note that the devicetree activates the internal pullup and sets the active low flag */
	/*   so an external resistor is not needed and pressing the button causes a logic level of 1*/
	ret = gpio_pin_configure_dt(&led1, GPIO_OUTPUT_INACTIVE);
	if (ret < 0) {		
		return ret;
	}

	ret = gpio_pin_configure_dt(&but1, GPIO_INPUT);
	if (ret < 0) {
		return ret;
	}
	printf("BUT1 and LED 1 correctly configured\n");

	/* Set interrupt - note that this line only makes the button generate an INT. Does not set an ISR/callback*/
	ret = gpio_pin_interrupt_configure_dt(&but1, GPIO_INT_EDGE_TO_ACTIVE);
	if (ret < 0) {		
		return ret;
	}
	printf("BUT1 set to generate interrupt or rising edge\n");
		
	/* Add the INT ISR/callback function by calling gpio_add_callback()   */
	gpio_init_callback(&buttonCbData, buttonPressed, BIT(but1.pin));
	ret=gpio_add_callback(but1.port, &buttonCbData);
	if (ret < 0) {		
		return ret;
	}
	printf("Callback for BUT1 intrrupt is set \n");

	printf("Press BUT1 to toggle LED1 state\n");

	/* 
 	* No need for a while(1) at the end of the main. 
	* In Zephyr main() is a thread that can terminate without resetting the system 
	* and there is an idle() thread that is called when there are not other tasks/ints ready
	* The idle() thread activates the power saving modes, so it should be left running when possible
 	*/ 	

	return 0;
}